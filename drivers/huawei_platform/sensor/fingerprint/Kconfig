## drivers/huawei_platform/sensor/fingerprint/Kconfig
```kconfig
config FINGERPRINT
	tristate "fingerprint"
	default n
	help
		If you say yes here you get support for fingerprint.

config FINGERPRINT_FPC1150
	tristate "fingerprint fpc1150"
	default n
	help
		If you say yes here you get support for fingerprint chip 1150.
```

## drivers/vcodec/imagination-drm/Kconfig
```kconfig
menuconfig IMAGINATION_DRM_VCODEC
    tristate "Hi3xxx Support IMG Video Codec Drivers"
    default n
    ---help---
      This is the codec driver based on hi3xxx.

if IMAGINATION_DRM_VCODEC      
source "drivers/vcodec/imagination-drm/imgvideo/Kconfig"
source "drivers/vcodec/imagination-drm/vdec/Kconfig"
source "drivers/vcodec/imagination-drm/encode/Kconfig"
endif
```
